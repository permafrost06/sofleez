## boards/shields/sofleez/Kconfig.defconfig
```kconfig
if SHIELD_SOFLEEZ_LEFT

config ZMK_KEYBOARD_NAME
    default "sofleez"

config ZMK_SPLIT_ROLE_CENTRAL
    default y

endif # SHIELD_SOFLEEZ_LEFT

if SHIELD_SOFLEEZ_LEFT || SHIELD_SOFLEEZ_RIGHT

config ZMK_SPLIT
    default y

endif # SHIELD_SOFLEEZ_LEFT || SHIELD_SOFLEEZ_RIGHT
```

## boards/shields/sofleez/Kconfig.shield
```kconfig
config SHIELD_SOFLEEZ_LEFT
    def_bool $(shields_list_contains,sofleez_left)

config SHIELD_SOFLEEZ_RIGHT
    def_bool $(shields_list_contains,sofleez_right)
```
